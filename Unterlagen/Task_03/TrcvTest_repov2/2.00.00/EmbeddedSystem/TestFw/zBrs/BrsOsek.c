/*  *****   STARTSINGLE_OF_MULTIPLE_COMMENT    *****  */




/*****************************************************************************/
/**
 * \file    BrsOsek.C
 * \brief   Basic Runtime System osCAN support, Code
 *
 *  This is the OSEK OS support file of the Basic Runtime System (BRS).
 *
 * \attention 
 *  CAUTION:     !!!! THIS IS ONLY A VERY SIMPLE EXAMPLE OF OSCAN USAGE !!!!
 *               !!!!      WHICH IS NOT RECOMMENDED FOR CUSTOMERS       !!!!
 *               It only shows compiling compatibility of CANbedded and osCAN
 *                                
 * \attention Please note:
 *  The demo and example program only shows special aspects of the software. 
 *  With regard to the fact that this program is meant for demonstration purposes 
 *  Vector Informatik's liability shall be expressly excluded in cases of 
 *  ordinary negligence, to the extent admissible by law or statute. 
 *
 *****************************************************************************
 *               C O P Y R I G H T
 *****************************************************************************
 * Copyright (c) 2005 by Vector Informatik GmbH.      All rights reserved.
 *
 *       This software is copyright protected and 
 *       proporietary to Vector Informatik GmbH.
 *       Vector Informatik GmbH grants to you only
 *       those rights as set out in the license conditions.
 *       All other rights remain with Vector Informatik GmbH.
 * 
 *       Diese Software ist urheberrechtlich geschuetzt. 
 *       Vector Informatik GmbH raeumt Ihnen an dieser Software nur 
 *       die in den Lizenzbedingungen ausdruecklich genannten Rechte ein.
 *       Alle anderen Rechte verbleiben bei Vector Informatik GmbH.
 *
 *****************************************************************************
 * \author       A U T H O R   I D E N T I T Y
 *****************************************************************************
 - Initials     Name                      Company
 - ********     *********************     ************************************
 - Ra           Andreas Raisch            Vector Informatik GmbH
 - Uf           Ulrich Frank              Vector Informatik GmbH
 - Get          Matthias Gette            Vector Informatik GmbH
 - Mas          Markus Schwarz            Vector Informatik GmbH
 - Ms           Gunnar Meiss              Vector Informatik GmbH
 *****************************************************************************
 * \version     R E V I S I O N   H I S T O R Y
 *****************************************************************************
 - Date         Version Author  Description
 - **********   ******* ******  ************************************
 - 02-08-14     1.00.00 Ra      First Version
 - 02-10-23     1.01.00 Uf      ESCAN00003982: StartupHook removed, 
                                               added Osek2.2 support
 - 2003-07-24   1.02.00 Uf      Comments changed to doxygen style
 - 2003-10-17   1.02.01 Get     ESCAN00006810: Compilers may report an error
                                               when encountering an empty source file
 - 2003-10-27   1.02.02 Uf      ESCAN00006883: Organi comment moved in header
 - 2003-11-06   1.03.00 Ra      Legal text added, comments 
 - 2004-04-19   1.04.00 Get     Support for ISR split added
 - 2004-10-26   1.05.00 Uf      backgroundTask added
 - 2004-11-18   2.00.00 Ra      Changed to Vector types
 - 2004-12-21   2.00.01 Uf      Error hook signature fixed
 - 2005-01-11   2.00.02 Uf      MISRA compliant doxygen attributes
 - 2005-03-16   2.00.03 Uf      Use v_memrom qualifier for const variables
 - 2005-05-30   2.01.00 Get     Error hook moved to BrsHwISR whenever C_ENABLE_ISR_SPLIT
                                is defined
 - 2005-08-10   2.01.01 Get     (void) cast of OS functions to satisfy Pc-Lint added
 - 2005-11-18   2.01.02 Uf      Removed ticks in comments
 - 2005-12-06   2.02.00 Uf      Added filter rule warnings
 - 2006-11-02   2.02.01 Ms      Added AUTOSAR support
 - 2007-04-05   2.02.02 Ms      Updated AUTOSAR support
 - 2007-11-23   2.02.03 Et      set osdOSEK2_2 (MICROSAR OS)
 *****************************************************************************/

/*lint -e537 */ /* Do not inform for repeated include file */
/*lint -e766 */ /* Allow unused include files */

/*****************************************************************************
 * Include the files necessary for the Basic Runtime System (BRS)
 *****************************************************************************/

/*
 * Description: The BrsCfg header is used to configure different types of
 *              tests and system setups. Therefore it must be included first
 *              in each BRS and test module.
 *              This file is part of the BRS.
 */
#include "BrsCfg.H"


/*
 * Description: The V_Cfg header is generated by the generation tool. Important 
 *              information like CPU and compiler type, manufacturer information
 *              and a list of currently used CANbedded modules is defined here.
 */
#include "V_Cfg.H"

#if defined( VGEN_ENABLE_CAN_DRV )
/*
 * Description: The CAN_CFG header provides information about whether to split
 *              the interrupt functions
 */
#include "CAN_Cfg.H"
#endif

/*
 * Description: The V_Def header provides types and definitions common to all 
 *              VECTOR CANbedded modules.
 */
#include "V_Def.H"

/*
 * Description: The BrsOSEK header provides all the necessary interfaces, if
 *              an OSEK operating system is used with the BRS instead of the
 *              BRS time base handler.
 */
#include "BrsOsek.h"

/****************************************************************************/
#if defined( BRS_ENABLE_OSEKOS )
/*****************************************************************************
 * Do all further handling only, if this module is used in the current 
 * configuration
 *****************************************************************************/

#if defined( uint8 )
# undef uint8
#endif

/*
 * Description: The example also supports the OSEK OS instead its own time base
 *              handler. In that case this additional header is necessary, too.
 */

#if defined ( V_OSTYPE_AUTOSAR )
# include "os.h"
//# define osdOSEK2_2
#elif defined ( V_OSTYPE_OSEK ) || defined ( VGEN_CANGEN_VERSION )
# include <osek.h> 
#elif defined ( V_OSTYPE_NONE )
#else
# error "V_OSTYPE is not defined!"
#endif

/*
 * Description: The BrsMain header provides all the necessary interfaces of
 *              the BRS main system.
 *              This file is part of the BRS.
 */
#include "BrsMain.H"

#endif /* BRS_ENABLE_OSEKOS */

/******************************************************************************
 * Version check
 ******************************************************************************/
#if( BRS_OSEK_VERSION != 0x0202 )
  #error "Header and source file are inconsistent!"
#endif
#if( BRS_OSEK_RELEASE_VERSION != 0x03 )
  #error "Different release versions in Header and Source used!"
#endif


/*******************************************************************************
* Global variables
*******************************************************************************/
/* None used */


/*******************************************************************************
 * Global const variables
 *******************************************************************************/

#if defined ( C_COMP_IAR_M16C )
  #if defined ( _NEAR_ )
  /* Set const data to const segment, don't initialize */
  #pragma memory=constseg(CONST_DATA) :far
  #endif
#endif /*C_COMP_IAR_M16C*/

/** 
 * \var kBrsOsekMainVersion
 *      Stores the BCD coded main-version of this file.
 */
/**
 * \var kBrsOsekSubVersion 
 *      Stores the BCD coded sub-version of this file.
 */
/** 
 * \var kBrsOsekReleaseVersion 
 *      Stores the BCD coded release-version of this file.
 */
V_MEMROM0 V_MEMROM1 vuint8 V_MEMROM2 kBrsOsekMainVersion    = (vuint8)(BRS_OSEK_VERSION >> 8);
V_MEMROM0 V_MEMROM1 vuint8 V_MEMROM2 kBrsOsekSubVersion     = (vuint8)(BRS_OSEK_VERSION); /*lint !e778 */
V_MEMROM0 V_MEMROM1 vuint8 V_MEMROM2 kBrsOsekReleaseVersion = (vuint8)(BRS_OSEK_RELEASE_VERSION);

#if defined ( C_COMP_IAR_M16C )
  #if defined ( _NEAR_ )
  /* Normal segment usage */
  #pragma memory=default
  #endif
#endif /*C_COMP_IAR_M16C*/

/****************************************************************************/
#if defined( BRS_ENABLE_OSEKOS )
/*****************************************************************************
 * Do all further handling only, if this module is used in the current 
 * configuration
 *****************************************************************************/

/*******************************************************************************
* Local variables
*******************************************************************************/
DeclareAlarm(CyclicAlarm_1ms);

/*******************************************************************************
* Local const variables
*******************************************************************************/
#if defined ( C_COMP_IAR_M16C )
  #if defined ( _NEAR_ )
  /* Set const data to const segment, don't initialize */
  #pragma memory=constseg(CONST_DATA) :far
  #endif
#endif

/* None used */

#if defined ( C_COMP_IAR_M16C )
  #if defined ( _NEAR_ )
  /* Normal segment usage */
  #pragma memory=default
  #endif
#endif


/*******************************************************************************
* Prototypes of local functions 
*******************************************************************************/
/* Not used */

/*******************************************************************************
* Function definitions
*******************************************************************************/

/*******************************************************************************/
/**
 * \brief Task implementation for OSEK/OS
 *        mainTask gets an event each milisecond and then calls the 
 *        BrsMainMilliSecondHandler
 *
 * \attention THIS IS ONLY A VERY SIMPLE EXAMPLE OF OSCAN USAGE WHICH IS NOT RECOMMENDED FOR CUSTOMERS
 *            It only shows compiling compatibility of CANbedded and osCAN
 *
 * \pre       Called by OSEK/OS when the 1ms event has been set
 *
 * \post      BRS 1ms cycle function has been executed
 */
/*****************************************************************************/
TASK(mainTask)
{
  EventMaskType ev;

  (void)SetRelAlarm(CyclicAlarm_1ms, MSEC(1), MSEC(1));

  for(;;) {
    (void)WaitEvent(EvCyclicAlarm_1ms);
    (void)GetEvent(mainTask, &ev);
    (void)ClearEvent(ev);
    if(ev & EvCyclicAlarm_1ms) {
      /* 1ms event detected, call the ms handler */
      BrsMainMilliSecondHandler();
    }
  }
}

TASK(SchM_AsyncTask_1)
{
  vuint8 dummy=0;

  dummy+=1;
 // TerminateTask();
}

TASK(SchM_AsyncTask_2)
{
  vuint8 dummy=0;

  dummy+=1;
//  TerminateTask();
}

TASK(SchM_SyncTask_1)
{
  vuint8 dummy= 0;

  dummy+=1;
 // TerminateTask();
}

TASK(SchM_SyncTask_2)
{
  vuint8 dummy=0;

  dummy+=1;
//  TerminateTask();
}

/*******************************************************************************/
/**
 * \brief BackgroundTask implementation for OSEK/OS
 *        backgroundTask will called endles until no higher prio task is ready 
 *        to run.
 *
 * \attention THIS IS ONLY A VERY SIMPLE EXAMPLE OF OSCAN USAGE WHICH IS NOT RECOMMENDED FOR CUSTOMERS
 *            It only shows compiling compatibility of CANbedded and osCAN
 *
 * \pre       Called by OSEK/OS when nothing else is to be done (idle)
 *
 * \post      BRS background function has been executed
 */
/*****************************************************************************/
TASK(backgroundTask)
{
  for(;;) {
      BrsMainBackgroundFunc();
      (void)Schedule();
  }
}

#if !defined( C_ENABLE_ISR_SPLIT )
/*******************************************************************************/
/**
 * \brief Error hook for OSEK/OS
 *        If an error occures the error hook will be called and the OSEK/OS will
 *        be shut down.
 *
 * \attention THIS IS ONLY A VERY SIMPLE EXAMPLE OF OSCAN USAGE WHICH IS NOT RECOMMENDED FOR CUSTOMERS
 *            It only shows compiling compatibility of CANbedded and osCAN
 *
 * \pre       Called by OSEK/OS when the OS shuts down due to an detected error.
 *
 * \post      System is shut down, no more action now ...
 */
/*****************************************************************************/
#if STATUS_LEVEL == EXTENDED_STATUS
  #if defined (osdOSEK2_2)
    void ErrorHook(StatusType ErrorCode)
  #else 
    void ErrorHook(StatusType ErrorCode, uint16 uiError, char *pModule, int uiLine)
  #endif
#else
  #if defined (osdOSEK2_2)
    void ErrorHook(StatusType ErrorCode)
  #else 
    void ErrorHook(StatusType ErrorCode, uint16 uiError)
  #endif
#endif
{
  #if defined (osdOSEK2_2)
    uint16 uiError = OSErrorGetosCANError();
  #else
    #if STATUS_LEVEL == EXTENDED_STATUS
      uiLine = uiLine;     /* because of compiler warning */
      pModule = pModule;   /* because of compiler warning */
    #endif
    uiError = uiError;     /* because of compiler warning */
  #endif

  if (ErrorCode == E_OS_NOFUNC) {
    return;
  }

  ShutdownOS(ErrorCode);
}
#endif /* !C_ENABLE_ISR_SPLIT */

#endif /* BRS_ENABLE_OSEKOS */


/*  *****   STOPSINGLE_OF_MULTIPLE   *****  */
/************   Organi, Version 3.6.8 Vector-Informatik GmbH  ************/
