#if defined( C_KOMMENTAR_VECTOR )
/**********************************************************************************************************************
 *  -------------------------------------------------------------------------------------------------------------------
 *
 *                                souce code for internal usage
 *
 *                          *****          Do not deliver       *****
 *
 *  -------------------------------------------------------------------------------------------------------------------
 *  -------------------------------------------------------------------------------------------------------------------
 *  FILE DESCRIPTION
 *  -------------------------------------------------------------------------------------------------------------------
 *         File:  FrTrcv_Compiler_Cfg.inc
 *    Component:  -
 *       Module:  -
 *    Generator:  -
 *
 *  Description:  This file has to be included in _Compiler_Cfg.h
 *                This header comment will be removed during delivery
 *  -------------------------------------------------------------------------------------------------------------------
 *  MISRA VIOLATIONS
 *  -------------------------------------------------------------------------------------------------------------------
 *      
 *  
 *********************************************************************************************************************/

/**********************************************************************************************************************
 *  AUTHOR IDENTITY
 *  -------------------------------------------------------------------------------------------------------------------
 *  Name                          Initials      Company
 *  -------------------------------------------------------------------------------------------------------------------
 *  Heike Honert                  visht         Vector Informatik
 *  Andreas Herkommer             vishr         Vector Informatik
 *  -------------------------------------------------------------------------------------------------------------------
 *  REVISION HISTORY
 *  -------------------------------------------------------------------------------------------------------------------
 *  Version   Date        Author  Change Id     Description
 *  -------------------------------------------------------------------------------------------------------------------
 *  01.00.00  2009-01-13  visht                 Template creation
 *  01.00.01  2009-02-24  visht                 <MSN>_PBCFG_ROOT added
 *  01.00.02  2009-02-25  vishr                 Adaptation for FrTrcv
 *  01.01.00  2015-01-28  vishr                 Rework with vendor & Trcv infix
 *********************************************************************************************************************/

#endif

/**********************************************************************************************************************
 *  FRTRCV TJA1080 START 
 *********************************************************************************************************************/

#define FRTRCV_30_TJA1080_CONST
#define FRTRCV_30_TJA1080_VAR_NOINIT
#define FRTRCV_30_TJA1080_VAR_ZERO_INIT
#define FRTRCV_30_TJA1080_CODE
#define FRTRCV_30_TJA1080_APPL_DATA

/**********************************************************************************************************************
 *  FRTRCV TJA1080 END
 *********************************************************************************************************************/
