#if defined( C_KOMMENTAR_VECTOR )
/**********************************************************************************************************************
 *  -------------------------------------------------------------------------------------------------------------------
 *
 *                                souce code for internal usage
 *
 *                          *****          Do not deliver       *****
 *
 *  -------------------------------------------------------------------------------------------------------------------
 *  -------------------------------------------------------------------------------------------------------------------
 *  FILE DESCRIPTION
 *  -------------------------------------------------------------------------------------------------------------------
 *         File:  FrTrcv_MemMap.inc
 *    Component:  -
 *       Module:  -
 *    Generator:  -
 *
 *  Description:  This file has to be included in _MemMap.h
 *                This header comment will be removed during delivery
 *  -------------------------------------------------------------------------------------------------------------------
 *  MISRA VIOLATIONS
 *  -------------------------------------------------------------------------------------------------------------------
 *      
 *  
 *********************************************************************************************************************/

/**********************************************************************************************************************
 *  AUTHOR IDENTITY
 *  -------------------------------------------------------------------------------------------------------------------
 *  Name                          Initials      Company
 *  -------------------------------------------------------------------------------------------------------------------
 *  Heike Honert                  visht         Vector Informatik
 *  Andreas Herkommer             vishr         Vector Informatik
 *  -------------------------------------------------------------------------------------------------------------------
 *  REVISION HISTORY
 *  -------------------------------------------------------------------------------------------------------------------
 *  Version   Date        Author  Change Id     Description
 *  -------------------------------------------------------------------------------------------------------------------
 *  01.00.00  2009-01-26  visht                 Template creation
 *  01.00.01  2009-02-24  visht                 <MSN>_START_SEC_PBCFG_ROOT and <MSN>_STOP_SEC_PBCFG_ROOT added
 *  01.00.02  2009-02-25  vishr                 Adaptation for FrTrcv
 *  01.01.00  2015-01-28  vishr                 Rework with vendor & Trcv infix
 *  01.01.01  2015-10-07  vishr                 Removed unused section
 *********************************************************************************************************************/

#endif

/**********************************************************************************************************************
 *  FRTRCV TJA1080 START 
 *********************************************************************************************************************/

/*******  CODE sections **********************************************************************************************/

#ifdef FRTRCV_30_TJA1080_START_SEC_CODE 
    #undef FRTRCV_30_TJA1080_START_SEC_CODE 
    #define START_SEC_CODE
#endif

#ifdef FRTRCV_30_TJA1080_STOP_SEC_CODE 
    #undef FRTRCV_30_TJA1080_STOP_SEC_CODE 
    #define STOP_SEC_CODE
#endif


/*******  CONST sections  ********************************************************************************************/

/* CONST sections */

#ifdef FRTRCV_30_TJA1080_START_SEC_CONST_UNSPECIFIED 
    #undef FRTRCV_30_TJA1080_START_SEC_CONST_UNSPECIFIED 
    #define START_SEC_CONST_UNSPECIFIED
#endif

#ifdef FRTRCV_30_TJA1080_STOP_SEC_CONST_UNSPECIFIED 
    #undef FRTRCV_30_TJA1080_STOP_SEC_CONST_UNSPECIFIED 
    #define STOP_SEC_CONST
#endif

#ifdef FRTRCV_30_TJA1080_START_SEC_CONST_32BIT 
    #undef FRTRCV_30_TJA1080_START_SEC_CONST_32BIT 
    #define START_SEC_CONST_32BIT
#endif

#ifdef FRTRCV_30_TJA1080_STOP_SEC_CONST_32BIT 
    #undef FRTRCV_30_TJA1080_STOP_SEC_CONST_32BIT 
    #define STOP_SEC_CONST
#endif

#ifdef FRTRCV_30_TJA1080_START_SEC_CONST_16BIT 
    #undef FRTRCV_30_TJA1080_START_SEC_CONST_16BIT 
    #define START_SEC_CONST_16BIT
#endif

#ifdef FRTRCV_30_TJA1080_STOP_SEC_CONST_16BIT 
    #undef FRTRCV_30_TJA1080_STOP_SEC_CONST_16BIT 
    #define STOP_SEC_CONST
#endif

#ifdef FRTRCV_30_TJA1080_START_SEC_CONST_8BIT 
    #undef FRTRCV_30_TJA1080_START_SEC_CONST_8BIT 
    #define START_SEC_CONST_8BIT
#endif

#ifdef FRTRCV_30_TJA1080_STOP_SEC_CONST_8BIT 
    #undef FRTRCV_30_TJA1080_STOP_SEC_CONST_8BIT 
    #define STOP_SEC_CONST
#endif


/*******  VAR sections  **********************************************************************************************/


#ifdef FRTRCV_30_TJA1080_START_SEC_VAR_ZERO_INIT_UNSPECIFIED 
    #undef FRTRCV_30_TJA1080_START_SEC_VAR_ZERO_INIT_UNSPECIFIED 
    #define START_SEC_VAR_ZERO_INIT_UNSPECIFIED
#endif

#ifdef FRTRCV_30_TJA1080_STOP_SEC_VAR_ZERO_INIT_UNSPECIFIED 
    #undef FRTRCV_30_TJA1080_STOP_SEC_VAR_ZERO_INIT_UNSPECIFIED 
    #define STOP_SEC_VAR
#endif

#ifdef FRTRCV_30_TJA1080_START_SEC_VAR_NOINIT_UNSPECIFIED 
    #undef FRTRCV_30_TJA1080_START_SEC_VAR_NOINIT_UNSPECIFIED 
    #define START_SEC_VAR_NOINIT_UNSPECIFIED
#endif

#ifdef FRTRCV_30_TJA1080_STOP_SEC_VAR_NOINIT_UNSPECIFIED 
    #undef FRTRCV_30_TJA1080_STOP_SEC_VAR_NOINIT_UNSPECIFIED 
    #define STOP_SEC_VAR
#endif

#ifdef FRTRCV_30_TJA1080_START_SEC_VAR_NOINIT_32BIT 
    #undef FRTRCV_30_TJA1080_START_SEC_VAR_NOINIT_32BIT 
    #define START_SEC_VAR_NOINIT_32BIT
#endif

#ifdef FRTRCV_30_TJA1080_STOP_SEC_VAR_NOINIT_32BIT 
    #undef FRTRCV_30_TJA1080_STOP_SEC_VAR_NOINIT_32BIT 
    #define STOP_SEC_VAR
#endif


/**********************************************************************************************************************
 *  FRTRCV TJA1080 END
 *********************************************************************************************************************/
