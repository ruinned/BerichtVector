#if defined( C_KOMMENTAR_VECTOR )
/***********************************************************************************************************************
 *  -------------------------------------------------------------------------------------------------------------------
 *
 *                                souce code for internal usage
 *
 *                          *****          Do not deliver       *****
 *
 *  -------------------------------------------------------------------------------------------------------------------
 *  -------------------------------------------------------------------------------------------------------------------
 *  FILE DESCRIPTION
 *  -------------------------------------------------------------------------------------------------------------------
 *         File:  Mip_MemMap.inc
 *    Component:  MipProject
 *       Module:  Mip
 *    Generator:  -
 *
 *  Description:  This file has to be included in _MemMap.h
 *                This header comment will be removed during delivery
 *  -------------------------------------------------------------------------------------------------------------------
 *  MISRA VIOLATIONS
 *  -------------------------------------------------------------------------------------------------------------------
 *      
 *  
 **********************************************************************************************************************/
#endif

/***********************************************************************************************************************
 *  MIP START 
 **********************************************************************************************************************/

/*******  CODE sections **********************************************************************************************/
#ifdef MIP_START_SEC_CODE
  #undef MIP_START_SEC_CODE                         /* PRQA S 0841 */ /* MD_MSR_19.6 */
  #define START_SEC_CODE
#endif
#ifdef MIP_STOP_SEC_CODE
  #undef MIP_STOP_SEC_CODE                          /* PRQA S 0841 */ /* MD_MSR_19.6 */ 
  #define STOP_SEC_CODE
#endif

/*******  CONST sections  ********************************************************************************************/

/* CONST sections */

#ifdef MIP_START_SEC_CONST_32
# undef MIP_START_SEC_CONST_32 /* PRQA S 0841 */ /* MD_MSR_19.6 */ 
# define START_SEC_CONST_32
#endif
#ifdef MIP_STOP_SEC_CONST_32
# undef MIP_STOP_SEC_CONST_32 /* PRQA S 0841 */ /* MD_MSR_19.6 */
# define STOP_SEC_CONST
#endif


/*******  VAR sections  **********************************************************************************************/

/* VAR NOINIT sections */

#ifdef MIP_START_SEC_VAR_NOINIT_8
# undef MIP_START_SEC_VAR_NOINIT_8 /* PRQA S 0841 */ /* MD_MSR_19.6 */ 
# define START_SEC_VAR_NOINIT_8
#endif
#ifdef MIP_STOP_SEC_VAR_NOINIT_8
# undef MIP_STOP_SEC_VAR_NOINIT_8 /* PRQA S 0841 */ /* MD_MSR_19.6 */ 
# define STOP_SEC_VAR
#endif

#ifdef MIP_START_SEC_VAR_NOINIT_32
# undef MIP_START_SEC_VAR_NOINIT_32 /* PRQA S 0841 */ /* MD_MSR_19.6 */ 
# define START_SEC_VAR_NOINIT_32
#endif
#ifdef MIP_STOP_SEC_VAR_NOINIT_32
# undef MIP_STOP_SEC_VAR_NOINIT_32 /* PRQA S 0841 */ /* MD_MSR_19.6 */
# define STOP_SEC_VAR
#endif

/* VAR ZERO INIT sections */
#ifdef MIP_START_SEC_VAR_ZERO_INIT_8
# undef MIP_START_SEC_VAR_ZERO_INIT_8 /* PRQA S 0841 */ /* MD_MSR_19.6 */ 
# define START_SEC_VAR_ZERO_INIT_8
#endif
#ifdef MIP_STOP_SEC_VAR_ZERO_INIT_8
# undef MIP_STOP_SEC_VAR_ZERO_INIT_8 /* PRQA S 0841 */ /* MD_MSR_19.6 */
# define STOP_SEC_VAR
#endif

#ifdef MIP_START_SEC_VAR_ZERO_INIT_UNSPECIFIED
# undef MIP_START_SEC_VAR_ZERO_INIT_UNSPECIFIED /* PRQA S 0841 */ /* MD_MSR_19.6 */
# define START_SEC_VAR_ZERO_INIT_UNSPECIFIED
#endif
#ifdef MIP_STOP_SEC_VAR_ZERO_INIT_UNSPECIFIED
# undef MIP_STOP_SEC_VAR_ZERO_INIT_UNSPECIFIED /* PRQA S 0841 */ /* MD_MSR_19.6 */
# define STOP_SEC_VAR
#endif

#ifdef MIP_START_SEC_PBCFG
# undef MIP_START_SEC_PBCFG /* PRQA S 0841 */ /* MD_MSR_19.6 */ 
# define START_SEC_CONST_PBCFG
#endif
#ifdef MIP_STOP_SEC_PBCFG
# undef MIP_STOP_SEC_PBCFG /* PRQA S 0841 */ /* MD_MSR_19.6 */ 
# define STOP_SEC_CONST
#endif

/***********************************************************************************************************************
 *  MIP END
 **********************************************************************************************************************/
