#if defined( C_KOMMENTAR_VECTOR )
/***********************************************************************************************************************
 *  -------------------------------------------------------------------------------------------------------------------
 *
 *                                souce code for internal usage
 *
 *                          *****          Do not deliver       *****
 *
 *  -------------------------------------------------------------------------------------------------------------------
 *  -------------------------------------------------------------------------------------------------------------------
 *  FILE DESCRIPTION
 *  -------------------------------------------------------------------------------------------------------------------
 *         File:  Mip_Compiler_Cfg.inc
 *    Component:  MipProject
 *       Module:  Mip
 *    Generator:  -
 *
 *  Description:  This file has to be included in _Compiler_Cfg.h
 *                This header comment will be removed during delivery
 *  -------------------------------------------------------------------------------------------------------------------
 *  MISRA VIOLATIONS
 *  -------------------------------------------------------------------------------------------------------------------
 *      
 *  
 **********************************************************************************************************************/
#endif

/***********************************************************************************************************************
 *  MIP START 
 **********************************************************************************************************************/

#define MIP_CODE

#define MIP_CONST
#define MIP_APPL_VAR

#define MIP_APPL_CODE
#define MIP_VAR_ZERO_INIT
#define MIP_VAR_NOINIT

#define MIP_PBCFG

/***********************************************************************************************************************
 *  MIP END
 **********************************************************************************************************************/
